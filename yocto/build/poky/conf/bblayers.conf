## yocto/build/poky/conf/bblayers.conf
```bitbake
# POKY_BBLAYERS_CONF_VERSION is increased each time build/conf/bblayers.conf
# changes incompatibly
POKY_BBLAYERS_CONF_VERSION = "2"

BBPATH = "${TOPDIR}"
SRCPATH = "${TOPDIR}/../../src"
BBFILES ?= ""

BBLAYERS ?= " \
  ${SRCPATH}/poky/meta \
  ${SRCPATH}/poky/meta-poky \
  ${SRCPATH}/poky/meta-yocto-bsp \
  ${SRCPATH}/meta-openembedded/meta-oe \
  ${SRCPATH}/meta-openembedded/meta-networking \
  ${SRCPATH}/meta-openembedded/meta-python \
  ${SRCPATH}/meta-raspberrypi \
  ${SRCPATH}/meta-inky-soup \
  "
```

## yocto/meta-inky-soup/conf/layer.conf
```bitbake
# Layer configuration for meta-inky-soup.
BBPATH .= ":${LAYERDIR}"

BBFILES += "${LAYERDIR}/recipes-*/*/*.bb \
            ${LAYERDIR}/recipes-*/*/*.bbappend"

BBFILE_COLLECTIONS += "meta-inky-soup"
BBFILE_PATTERN_meta-inky-soup = "^${LAYERDIR}/"
BBFILE_PRIORITY_meta-inky-soup = "7"

LAYERDEPENDS_meta-inky-soup = "core networking-layer pi-base raspberrypi rust-bin-layer"
LAYERSERIES_COMPAT_meta-inky-soup = "scarthgap"
```

## yocto/meta-inky-soup/conf/machine/raspberrypi-inky-soup.conf
```bitbake
#@TYPE: Machine
#@NAME: Inky Soup Unified Raspberry Pi (Zero W + Zero 2 W)
#@DESCRIPTION: Unified machine configuration for Inky Soup e-ink display project
#              supporting both Raspberry Pi Zero W and Zero 2 W.
#              Uses ARMv6 (hard-float) for binary compatibility across both boards.

# Inherit raspberrypi0-wifi overrides so BSP metadata is found.
MACHINEOVERRIDES =. "raspberrypi0-wifi:"

# Use ARM1176JZF-S tuning (ARMv6 with hard-float VFP).
# This runs natively on Zero W and in compatibility mode on Zero 2 W.
# Zero 2 W's Cortex-A53 handles ARMv6 code with minimal overhead.
DEFAULTTUNE = "arm1176jzfshf"
require conf/machine/include/tune-arm1176jzf-s.inc
include conf/machine/include/rpi-base.inc

# WiFi and Bluetooth firmware for both Zero W and Zero 2 W.
MACHINE_EXTRA_RRECOMMENDS += "\
    linux-firmware-rpidistro-bcm43430 \
    bluez-firmware-rpidistro-bcm43430a1-hcd \
    linux-firmware-rpidistro-bcm43436 \
    linux-firmware-rpidistro-bcm43436s \
    bluez-firmware-rpidistro-bcm43430b0-hcd \
"

# Device trees for both Zero W and Zero 2 W.
# The bootloader auto-selects based on detected hardware.
RPI_KERNEL_DEVICETREE = " \
    broadcom/bcm2708-rpi-zero-w.dtb \
    broadcom/bcm2710-rpi-zero-2-w.dtb \
"

# SPI overlay for Inky Impression e-ink display.
# The display uses SPI for data and GPIO for control signals.
RPI_KERNEL_DEVICETREE_OVERLAYS:append = " \
    overlays/spi0-0cs.dtbo \
"

# Serial console on GPIO pins (useful for debug without SSH).
SERIAL_CONSOLES = "115200;ttyS0"

# Kernel image for 32-bit ARM.
KERNEL_IMAGETYPE = "zImage"
SDIMG_KERNELIMAGE ?= "kernel.img"

# U-Boot configuration (not using U-Boot, direct kernel boot).
KERNEL_BOOTCMD ?= "bootz"

# ARM stub for early boot.
ARMSTUB ?= "armstub.bin"

# Machine features.
# - sdio: SD card and WiFi use SDIO bus.
# - wifi/bluetooth: Onboard wireless.
# - No pci (Zero doesn't have PCIe).
MACHINE_FEATURES += "sdio wifi bluetooth"
MACHINE_FEATURES:remove = "pci"

# Enable SPI and I2C in config.txt for Inky display.
# SPI: Main data bus for the e-ink controller.
# I2C: May be needed for display identification.
ENABLE_SPI_BUS = "1"
ENABLE_I2C = "1"

# GPU memory allocation (minimal - we don't need GPU for e-ink).
# Keep some for HDMI debug output.
GPU_MEM = "16"

# Enable HDMI output for debug console.
# This lets you plug in a monitor for troubleshooting.
HDMI_FORCE_HOTPLUG = "1"
```

## yocto/meta-inky-soup/wic/sdimage-ab.wks
```
# A/B partition layout for safe remote updates on SD card.
# Each rootfs gets its own partition - system updates the inactive one.
# Data partition persists across updates (WiFi credentials, images, config).
#
# Partition layout:
#   1: boot    - FAT32, kernel + bootloader (150MB)
#   2: rootfs_a - ext4, primary rootfs (800MB)
#   3: rootfs_b - ext4, backup rootfs for A/B updates (800MB)
#   4: data    - ext4, persistent data (rest of card)

part /boot --source bootimg-partition --ondisk mmcblk0 --fstype=vfat --label boot --active --align 4096 --size 150
part / --source rootfs --ondisk mmcblk0 --fstype=ext4 --label rootfs_a --align 4096 --size 800
part --ondisk mmcblk0 --fstype=ext4 --label rootfs_b --align 4096 --size 800
part /data --ondisk mmcblk0 --fstype=ext4 --label data --align 4096 --size 100
```

## yocto/src/meta-inky-soup/wic/sdimage-inky-soup.wks
```
# Inky Soup SD card image layout with A/B partitions
#
# Partition layout:
#   1: boot     (150MB, FAT32) - kernel, device tree, config.txt
#   2: rootfs_a (800MB, ext4)  - primary system (active on first boot)
#   3: rootfs_b (800MB, ext4)  - secondary system (for OTA updates)
#   4: data     (100MB, ext4)  - persistent storage (WiFi credentials, logs, config)
#
# A/B update flow:
#   1. Flash new image to inactive rootfs partition
#   2. Update boot config to switch active partition
#   3. Reboot into new system
#   4. If boot fails, fall back to previous partition
#
# The data partition survives all updates - WiFi credentials configured via
# nmcli/nmtui are stored in /data/NetworkManager/system-connections/ and
# bind-mounted into place on boot.

part /boot --source bootimg-partition --ondisk mmcblk0 --fstype=vfat --label boot --active --align 4096 --size 150
part / --source rootfs --ondisk mmcblk0 --fstype=ext4 --label rootfs_a --align 4096 --size 800
part --ondisk mmcblk0 --fstype=ext4 --label rootfs_b --align 4096 --size 800
part /data --ondisk mmcblk0 --fstype=ext4 --label data --align 4096 --size 100
```
